## conf/machine/formuler1.conf
```bitbake
#@TYPE: Machine
#@NAME: formuler f1
#@DESCRIPTION: Machine configuration for the formuler f1

SOC_FAMILY = "bcm7356"
CHIPSET = "bcm7356"

BRAND_OEM = "formuler"
MACHINE_BRAND = "Formuler"
MACHINE_NAME = "F1"

KERNEL_FILE = "kernel.bin"
ROOTFS_FILE = "rootfs.bin"
MTD_KERNEL = "mtd1"
MTD_ROOTFS = "mtd2"

MACHINE_FEATURES += " dvb-c textlcd videoenhancement skins1080 RCA HDMI YUV RC"

MKUBIFS_ARGS = "-m 2048 -e 126976 -c 8192"
UBINIZE_ARGS = "-m 2048 -p 128KiB"

RCTYPE = "18"

require conf/machine/include/formuler.inc
```

## conf/machine/formuler3.conf
```bitbake
#@TYPE: Machine
#@NAME: formuler f3
#@DESCRIPTION: Machine configuration for the formuler f3

SOC_FAMILY = "bcm7362"
CHIPSET = "bcm7362"

BRAND_OEM = "formuler"
MACHINE_BRAND = "Formuler"
MACHINE_NAME = "F3"

KERNEL_FILE = "kernel.bin"
ROOTFS_FILE = "rootfs.bin"
MTD_KERNEL = "mtd1"
MTD_ROOTFS = "mtd2"

MACHINE_FEATURES += " videoenhancement textlcd skins1080 HDMI"

MKUBIFS_ARGS = "-m 2048 -e 126976 -c 8192"
UBINIZE_ARGS = "-m 2048 -p 128KiB"

RCTYPE = "18"

require conf/machine/include/formuler.inc
```

## conf/machine/formuler4.conf
```bitbake
#@TYPE: Machine
#@NAME: formuler f4
#@DESCRIPTION: Machine configuration for the formuler f4

SOC_FAMILY = "bcm7362"
CHIPSET = "bcm7362"

BRAND_OEM = "formuler"
MACHINE_BRAND = "Formuler"
MACHINE_NAME = "F4"

KERNEL_FILE = "kernel.bin"
ROOTFS_FILE = "rootfs.bin"
MTD_KERNEL = "mtd1"
MTD_ROOTFS = "mtd2"

MACHINE_FEATURES += " videoenhancement textlcd skins1080 HDMI AV_JACK"

MKUBIFS_ARGS = "-m 2048 -e 126976 -c 8192"
UBINIZE_ARGS = "-m 2048 -p 128KiB"

RCTYPE = "18"

require conf/machine/include/formuler.inc
```

## conf/machine/formuler4turbo.conf
```bitbake
#@TYPE: Machine
#@NAME: formuler f4turbo
#@DESCRIPTION: Machine configuration for the formuler f4turbo

SOC_FAMILY = "bcm73625"
CHIPSET = "bcm73625"

BRAND_OEM = "formuler"
MACHINE_BRAND = "Formuler"
MACHINE_NAME = "F4 turbo"

KERNEL_FILE = "kernel.bin"
ROOTFS_FILE = "rootfs.bin"
MTD_KERNEL = "mtd1"
MTD_ROOTFS = "mtd2"

MACHINE_FEATURES += " videoenhancement textlcd dvb-c skins1080 HDMI AV_JACK"

MKUBIFS_ARGS = "-m 2048 -e 126976 -c 8192"
UBINIZE_ARGS = "-m 2048 -p 128KiB"

DVBMEDIASINK_CONFIG:append = " --with-h265 --with-vb6 --with-vb8 --with-spark"

RCTYPE = "18"

require conf/machine/include/formuler.inc
```
